## arch/eml/Kconfig
```kconfig
# SPDX-License-Identifier: GPL-2.0

menu "EFI Mode Linux options"

config EML
	bool
	default y
	select 64BIT
	select ARCH_HAS_FORTIFY_SOURCE
	select GENERIC_IRQ_SHOW
	select GENERIC_CPU_DEVICES
	select NO_DMA
	select NO_IOPORT_MAP
	select HAVE_PAGE_SIZE_4KB
	select HAVE_DEBUG_BUGVERBOSE
	select THREAD_INFO_IN_TASK
	select SPARSE_IRQ
	select OF_EARLY_FLATTREE if OF

config 64BIT
	bool
	default y

config MMU
	bool
	default n

config NO_IOMEM
	bool
	default y

config GENERIC_CALIBRATE_DELAY
	bool
	default y

config GENERIC_CSUM
	bool
	default y

config GENERIC_HWEIGHT
	bool
	default y

config HZ
	int
	default 100

config LOCKDEP_SUPPORT
	bool
	default y

config STACKTRACE_SUPPORT
	bool
	default y

config PGTABLE_LEVELS
	int
	default 1

config ARCH_DEFCONFIG
	string
	default "arch/eml/configs/defconfig"

config EML_CMDLINE
	string "Built-in kernel command line"
	default "console=ttyEML0"
	help
	  Default kernel command line used when no command line is passed
	  via the EFI Loaded Image Protocol. Set to empty string to disable.

endmenu
```

## arch/eml/configs/defconfig
```kconfig
# CONFIG_LOCALVERSION_AUTO is not set
# CONFIG_UTS_NS is not set
# CONFIG_TIME_NS is not set
# CONFIG_PID_NS is not set
# CONFIG_BLOCK_LEGACY_AUTOLOAD is not set
# CONFIG_BLK_DEV_WRITE_MOUNTED is not set
# CONFIG_MQ_IOSCHED_DEADLINE is not set
# CONFIG_MQ_IOSCHED_KYBER is not set
# CONFIG_BINFMT_SCRIPT is not set
# CONFIG_SLAB_MERGE_DEFAULT is not set
# CONFIG_COMPAT_BRK is not set
# CONFIG_STANDALONE is not set
# CONFIG_PREVENT_FIRMWARE_BUILD is not set
# CONFIG_BLK_DEV is not set
# CONFIG_INPUT_KEYBOARD is not set
# CONFIG_INPUT_MOUSE is not set
# CONFIG_SERIO is not set
# CONFIG_LEGACY_PTYS is not set
# CONFIG_LEGACY_TIOCSTI is not set
# CONFIG_LDISC_AUTOLOAD is not set
# CONFIG_HW_RANDOM is not set
# CONFIG_DEVMEM is not set
# CONFIG_HID_SUPPORT is not set
# CONFIG_VIRTIO_MENU is not set
# CONFIG_VHOST_MENU is not set
# CONFIG_DNOTIFY is not set
# CONFIG_INOTIFY_USER is not set
# CONFIG_MISC_FILESYSTEMS is not set
# CONFIG_SYMBOLIC_ERRNAME is not set
# CONFIG_SECTION_MISMATCH_WARN_ONLY is not set
# CONFIG_RUNTIME_TESTING_MENU is not set
```
